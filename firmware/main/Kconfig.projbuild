## firmware/main/Kconfig.projbuild
```kconfig
menu "DragonBench"
config DB_WIFI_SSID
    string "Optional station Wi-Fi SSID"
    default ""
config DB_WIFI_PASSWORD
    string "Optional station Wi-Fi password"
    default ""
config DB_AP_PASSWORD
    string "Direct access-point password"
    default "Dragon$ru1e"
config DB_HOSTNAME
    string "mDNS hostname (empty: per-board dragonbench-xxxxxx)"
    default ""
    help
        Empty derives a unique name from the MAC suffix, matching the access
        point name, so several boards on one network never share a name.
config DB_FIRMWARE_VERSION
    string "Firmware version"
    default "0.1.0"
config DB_TARGET_NAME
    string "Board profile identifier reported in events and /api/v1/device"
    default "esp32s3-n8r8" if IDF_TARGET_ESP32S3
    default ""
    help
        "<soc target>-<board>", one of the target values in
        protocol/event.schema.json. Set per board by the
        sdkconfig.defaults.<board> overlay. Only ESP32-S3 has a default
        board (N8R8); on any other SoC target an image without a board
        overlay fails to configure instead of reporting another SoC's board.
config DB_BOARD_PROFILE_PROVISIONAL
    bool "Board profile is provisional (not yet validated on the physical board)"
    default n
    help
        Set by a board profile built from seller or other secondary evidence
        before bring-up on the physical board. Reported as
        board_profile_provisional in /api/v1/device.
config DB_BOARD_FLASH_CLAIM_MB
    int "Flash size the board is claimed to have, MB (0: no claim)"
    range 0 128
    default 0
    help
        A claim, not a measurement: reported under memory.board_claim with
        DB_BOARD_MEMORY_CLAIM_SOURCE, next to the size the image measures.
config DB_BOARD_PSRAM_CLAIM_MB
    int "PSRAM size the board is claimed to have, MB (0: no claim)"
    range 0 32
    default 0
config DB_BOARD_MEMORY_CLAIM_SOURCE
    string "Evidence behind the board memory claim"
    default ""
    help
        Required when either claim is non-zero, for example
        "expected_from_seller".
config DB_RF_SWITCH_GPIO
    int "Antenna RF-switch select GPIO (-1 if the board has none)"
    range -1 48 if IDF_TARGET_ESP32S3
    range -1 28 if IDF_TARGET_ESP32C5
    default -1
    help
        Driven low at boot to select the onboard antenna.
        TinyS3[D]: GPIO38 (high selects the external U.FL connector).
config DB_STATUS_RGB_GPIO
    int "Onboard WS2812 status RGB LED data GPIO (-1 if the board has none)"
    range -1 48 if IDF_TARGET_ESP32S3
    range -1 28 if IDF_TARGET_ESP32C5
    default -1
    help
        Board-owned: DragonBench drives this LED as its status light (solid
        green when ready and idle, off at boot and throughout every run),
        and experiment fixture wiring may not claim the pin.
        Set per board by sdkconfig.defaults[.<board>].
        N8R8 and N16R8: GPIO48. TinyS3[D]: GPIO18.
config DB_STATUS_RGB_POWER_GPIO
    int "GPIO that powers the status RGB LED (-1 if it is always powered)"
    range -1 48 if IDF_TARGET_ESP32S3
    range -1 28 if IDF_TARGET_ESP32C5
    default -1
    help
        Board-owned like DB_STATUS_RGB_GPIO. The LED is unpowered whenever
        it is off. TinyS3[D]: GPIO17 supplies the LED's VDD directly.
config DB_STATUS_RGB_POWER_ACTIVE_LEVEL
    int "DB_STATUS_RGB_POWER_GPIO level that powers the LED"
    range 0 1
    default 1

choice DB_EXPERIMENT_PROFILE
    prompt "Experiment profile"
    default DB_EXPERIMENT_BASELINE
    help
        A DragonBench image is exactly one board profile plus exactly one
        experiment profile. An experiment profile is a narrow, reviewed
        characterization setup, not a bundle of feature flags; each one
        brings only the stimulus/acquisition code and fixture settings it
        needs. Select one with its sdkconfig.defaults.<experiment> overlay.
        See docs/EXPERIMENT_PROFILES.md.

config DB_EXPERIMENT_BASELINE
    bool "baseline: module workloads only, no fixture I/O"
    help
        The module characterization workloads. No stimulus or acquisition
        hardware beyond the module itself.

config DB_EXPERIMENT_FAN_CHARACTERIZATION
    bool "fan-characterization: bench PWM stimulus + tach (NOT product fan control)"
    help
        Bench-only stimulus/capture fixture for characterizing a fan
        specimen: the FAN_PWM_HOLD workload drives the gate of an EXTERNAL
        open-drain transistor stage that sinks the fan PWM line, and PCNT
        counts tach edges. No closed loop, no thresholds, no heater, and no
        product fan-control or safety policy. Select it with
        sdkconfig.defaults.fan-characterization plus a local overlay that
        states the wired GPIOs. ESP32-S3 only: no other SoC target has
        reviewed fixture pin guards. See docs/FAN_CHARACTERIZATION.md.

endchoice

if DB_EXPERIMENT_FAN_CHARACTERIZATION
menu "Fan-characterization fixture wiring"
config DB_FAN_PWM_GATE_GPIO
    int "Stimulus gate GPIO (-1: unset, build fails)"
    range -1 48 if IDF_TARGET_ESP32S3
    range -1 28 if IDF_TARGET_ESP32C5
    default -1
    help
        GPIO wired to the gate/base of the external open-drain stage. It
        never connects to the fan PWM lead directly. No default: the fixture
        wiring decides it.
config DB_FAN_GATE_SINK_LEVEL
    int "Gate level at which the stage sinks the fan PWM line (-1: unset)"
    range -1 1
    default -1
    help
        1 for a non-inverting stage (for example an N-channel MOSFET gate or
        NPN base: high sinks), 0 for an inverting one. The opposite level is
        the release level used at boot, run end, abort, and every error.
config DB_FAN_TACH_GPIO
    int "Conditioned tach input GPIO (-1: unset, build fails)"
    range -1 48 if IDF_TARGET_ESP32S3
    range -1 28 if IDF_TARGET_ESP32C5
    default -1
    help
        GPIO receiving the tach signal after the fixture's pull-up/level
        conditioning. It must never see more than 3.3 V.
config DB_FAN_TACH_INTERNAL_PULLUP
    bool "Enable the ESP32-S3 internal pull-up on the tach input"
    default n
    help
        Off by default: the fixture is expected to provide an external
        pull-up to 3.3 V sized for the tach output.
config DB_FAN_TACH_GLITCH_FILTER_NS
    int "PCNT glitch filter on the tach input, ns (0: off)"
    range 0 12700
    default 0
config DB_FAN_TACH_PPR
    int "Tach pulses per revolution (0: unknown, RPM not reported)"
    range 0 16
    default 0
    help
        Leave 0 until PPR is established for the specimen by independent
        evidence. With 0, events report edge frequency and "ppr": null only.
config DB_FAN_TACH_PPR_EVIDENCE
    string "Evidence reference establishing the configured PPR"
    default ""
    help
        Required when DB_FAN_TACH_PPR is non-zero, for example the bench
        record that compared tach edges with an optical tachometer.
endmenu
endif
endmenu
```

## firmware/targets/esp32s3/main/Kconfig.projbuild
```kconfig
menu "DragonBench"
config DB_WIFI_SSID
    string "Optional station Wi-Fi SSID"
    default ""
config DB_WIFI_PASSWORD
    string "Optional station Wi-Fi password"
    default ""
config DB_AP_PASSWORD
    string "Direct access-point password"
    default "Dragon$ru1e"
config DB_HOSTNAME
    string "mDNS hostname (empty: per-board dragonbench-xxxxxx)"
    default ""
    help
        Empty derives a unique name from the MAC suffix, matching the access
        point name, so several boards on one network never share a name.
config DB_FIRMWARE_VERSION
    string "Firmware version"
    default "0.1.0"
config DB_TARGET_NAME
    string "Target identifier reported in events and /api/v1/device"
    default "esp32s3-n8r8"
    help
        Must be one of the target values in protocol/event.schema.json.
        Set per board by the sdkconfig.defaults.<board> overlay.
config DB_RF_SWITCH_GPIO
    int "Antenna RF-switch select GPIO (-1 if the board has none)"
    range -1 48
    default -1
    help
        Driven low at boot to select the onboard antenna.
        TinyS3[D]: GPIO38 (high selects the external U.FL connector).

config DB_FAN_FIXTURE
    bool "Bench fan-characterization fixture (NOT product fan control)"
    default n
    help
        Bench-only stimulus/capture fixture for characterizing a fan
        specimen: the FAN_PWM_HOLD workload drives the gate of an EXTERNAL
        open-drain transistor stage that sinks the fan PWM line, and PCNT
        counts tach edges. No closed loop, no thresholds, no heater, and no
        product fan-control or safety policy. Normal profiles leave this off;
        enable it only with sdkconfig.defaults.fanfixture plus a local
        overlay that states the wired GPIOs. See docs/FAN_FIXTURE.md.

if DB_FAN_FIXTURE
config DB_FAN_PWM_GATE_GPIO
    int "Stimulus gate GPIO (-1: unset, build fails)"
    range -1 48
    default -1
    help
        GPIO wired to the gate/base of the external open-drain stage. It
        never connects to the fan PWM lead directly. No default: the fixture
        wiring decides it.
config DB_FAN_GATE_SINK_LEVEL
    int "Gate level at which the stage sinks the fan PWM line (-1: unset)"
    range -1 1
    default -1
    help
        1 for a non-inverting stage (for example an N-channel MOSFET gate or
        NPN base: high sinks), 0 for an inverting one. The opposite level is
        the release level used at boot, run end, abort, and every error.
config DB_FAN_TACH_GPIO
    int "Conditioned tach input GPIO (-1: unset, build fails)"
    range -1 48
    default -1
    help
        GPIO receiving the tach signal after the fixture's pull-up/level
        conditioning. It must never see more than 3.3 V.
config DB_FAN_TACH_INTERNAL_PULLUP
    bool "Enable the ESP32-S3 internal pull-up on the tach input"
    default n
    help
        Off by default: the fixture is expected to provide an external
        pull-up to 3.3 V sized for the tach output.
config DB_FAN_TACH_GLITCH_FILTER_NS
    int "PCNT glitch filter on the tach input, ns (0: off)"
    range 0 12700
    default 0
config DB_FAN_TACH_PPR
    int "Tach pulses per revolution (0: unknown, RPM not reported)"
    range 0 16
    default 0
    help
        Leave 0 until PPR is established for the specimen by independent
        evidence. With 0, events report edge frequency and "ppr": null only.
config DB_FAN_TACH_PPR_EVIDENCE
    string "Evidence reference establishing the configured PPR"
    default ""
    help
        Required when DB_FAN_TACH_PPR is non-zero, for example the bench
        record that compared tach edges with an optical tachometer.
endif
endmenu
```
